AUTOSAR XML (schema 00050)
package /ActiveEcuC
  ecuc value collection ActiveEcuC: ecuc-values=[Gpt, Mcl, EcuM, Dem, CanIf, MemAcc, Uart, Icu, Resource, Can, Rm, Dio, Fee, Mem, BaseNXP, Os, Platform, Wdg, Mcu, Port, MemMap, VTTMemMap]
