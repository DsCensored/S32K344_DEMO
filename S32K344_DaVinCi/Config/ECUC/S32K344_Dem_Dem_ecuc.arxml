AUTOSAR XML (schema 00050)
package /Dem
  module config Dem: implementation-config-variant=VARIANT-POST-BUILD
    CommonPublishedInformation:
      ArReleaseMajorVersion = 4
      ArReleaseMinorVersion = 7
      ArReleaseRevisionVersion = 0
      ModuleId = 54
      SwMajorVersion = 5
      SwMinorVersion = 0
      SwPatchVersion = 0
      VendorId = 43
    DemConfigSet
      DemEventParameter_0 (DemEventParameter):
        DemEventAvailable = true
        DemEventFailureCycleCounterThreshold = 0
        DemEventId = 1
        DemEventKind = DEM_EVENT_KIND_BSW
        DemFFPrestorageSupported = true
        DemOperationCycleRef = DemOperationCycle_0
        DemDebounceAlgorithmClass
          DemDebounceAlgorithmClass (DemDebounceCounterBased): DemDebounceCounterBasedClassRef=(unset)
    DemGeneral:
      DemAgingCycleCounterProcessing = DEM_PROCESS_AGINGCTR_INTERN
      DemAgingRequieresTestedCycle = true
      DemAvailabilitySupport = DEM_NO_AVAILABILITY
      DemClearDTCBehavior = DEM_CLRRESP_VOLATILE
      DemClearDTCLimitation = DEM_ALL_SUPPORTED_DTCS
      DemDataElementDefaultEndianness = BIG_ENDIAN
      DemDebounceCounterBasedSupport = true
      DemDebounceTimeBasedSupport = true
      DemDevErrorDetect = true
      DemDtcStatusAvailabilityMask = 0
      DemEventCombinationSupport = DEM_EVCOMB_DISABLED
      DemEventDisplacementStrategy = DEM_DISPLACEMENT_NONE
      DemEventMemoryEntryStorageTrigger = DEM_TRIGGER_ON_PENDING
      DemGeneralInterfaceSupport = true
      DemMaxNumberEventEntryPermanent = 0
      DemMaxNumberPrestoredFF = 0
      DemOBDSupport = DEM_OBD_NO_OBD_SUPPORT
      DemOccurrenceCounterProcessing = DEM_PROCESS_OCCCTR_TF
      DemOperationCycleStatusStorage = true
      DemPTOSupport = true
      DemResetConfirmedBitOnOverflow = true
      DemStatusBitHandlingTestFailedSinceLastClear = DEM_STATUS_BIT_NORMAL
      DemStatusBitStorageTestFailed = true
      DemSuppressionSupport = DEM_NO_SUPPRESSION
      DemTaskTime = 0.1
      DemTriggerDcmReports = true
      DemTriggerDltReports = true
      DemTriggerFiMReports = true
      DemTriggerMonitorInitBeforeClearOk = true
      DemTypeOfDTCSupported = DEM_DTC_TRANSLATION_ISO14229_1
      DemTypeOfFreezeFrameRecordNumeration = DEM_FF_RECNUM_CONFIGURED
      DemVersionInfoApi = true
      DemOperationCycle_0 (DemOperationCycle): DemOperationCycleAutomaticEnd=false, DemOperationCycleAutostart=false, DemOperationCycleType=DEM_OPCYC_TIME
      DemPrimaryMemory: DemMaxNumberEventEntryPrimary=1
