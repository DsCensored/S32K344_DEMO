AUTOSAR XML (schema 00050)
package /Mcl
  module config Mcl: implementation-config-variant=VARIANT-POST-BUILD
    CommonPublishedInformation:
      ArReleaseMajorVersion = 4
      ArReleaseMinorVersion = 7
      ArReleaseRevisionVersion = 0
      ModuleId = 255
      SwMajorVersion = 5
      SwMinorVersion = 0
      SwPatchVersion = 0
      VendorId = 43
    MclConfig
      dmaLogicChannel_Type_UART6_TX (dmaLogicChannel_Type):
        index = 0
        dmaLogicChannel_EnableGlobalConfig = false
        dmaLogicChannel_EnableScatterGather = false
        dmaLogicChannel_EnableTransferConfig = false
        dmaLogicChannel_ErrorInterruptCallback = NULL_PTR
        dmaLogicChannel_HwChId = DMA_IP_HW_CH_16
        dmaLogicChannel_HwInstId = DMA_IP_HW_INST_0
        dmaLogicChannel_InterruptCallback = Lpuart_6_Uart_Ip_DmaTxCompleteCallback
        dmaLogicChannel_LogicName = DMA_LOGIC_CH_0
        dmaLogicChannel_ConfigType
          dmaLogicChannel_GlobalConfigType
            dmaLogicChannelConfig_GlobalControlType: dmaGlobalControl_enBufferedWrites=false, dmaGlobalControl_enMasterIdReplication=false
            dmaLogicChannelConfig_GlobalInterruptType: dmaGlobalInterrupt_enDmaErrorInterrupt=false
            dmaLogicChannelConfig_GlobalPriorityType:
              dmaGlobalPriority_GroupPriority = DMA_IP_GROUP_PRIO0
              dmaGlobalPriority_LevelPriority = DMA_IP_LEVEL_PRIO0
              dmaGlobalPriority_disPreempt = false
              dmaGlobalPriority_enPreemption = false
            dmaLogicChannelConfig_GlobalRequestType: dmaGlobalRequest_enDmaRequest=false
          dmaLogicChannel_ScatterGatherConfigType
          dmaLogicChannel_TransferConfigType
            dmaLogicChannelConfig_TransferControlType:
              dmaLogicChannelConfig_DestinationStoreAddressType = 0U
              dmaLogicChannelConfig_ScatterGatherAddressType = 0U
              dmaLogicChannelConfig_bandwidthControl = DMA_IP_BWC_ENGINE_NO_STALL
              dmaLogicChannelConfig_disDmaAutoHwReq = false
              dmaLogicChannelConfig_enDmaHalfMajorInterrupt = false
              dmaLogicChannelConfig_enDmaMajorInterrupt = false
              dmaLogicChannelConfig_enEndOfPacketSignal = false
            dmaLogicChannelConfig_TransferDestinationType:
              dmaLogicChannelConfig_DestinationAddressType = 0
              dmaLogicChannelConfig_DestinationLastAddressAdjustmentType = 0
              dmaLogicChannelConfig_DestinationModuloType = 0
              dmaLogicChannelConfig_DestinationSignedOffsetType = 0
              dmaTransferConfig_TransferSizeType = DMA_IP_TRANSFER_SIZE_1_BYTE
            dmaLogicChannelConfig_TransferMajorLoopType: dmaLogicChannelConfig_MajorLoopCountType=1, dmaLogicChannelConfig_enMajorLoopLinkCh=false
            dmaLogicChannelConfig_TransferMinorLoopType:
              dmaLogicChannelConfig_MinorLoopSizeType = 0
              dmaLogicChannelConfig_OffsetValueType = 0
              dmaLogicChannelConfig_enDestinationOffset = false
              dmaLogicChannelConfig_enMinorLoopLinkCh = false
              dmaLogicChannelConfig_enSourceOffset = false
            dmaLogicChannelConfig_TransferSourceType:
              dmaLogicChannelConfig_SourceAddressType = 0
              dmaLogicChannelConfig_SourceLastAddressAdjustmentType = 0
              dmaLogicChannelConfig_SourceModuloType = 0
              dmaLogicChannelConfig_SourceSignedOffsetType = 0
              dmaTransferConfig_TransferSizeType = DMA_IP_TRANSFER_SIZE_1_BYTE
      dmaLogicChannel_Type_UART6_RX (dmaLogicChannel_Type):
        index = 1
        dmaLogicChannel_EnableGlobalConfig = false
        dmaLogicChannel_EnableScatterGather = false
        dmaLogicChannel_EnableTransferConfig = false
        dmaLogicChannel_ErrorInterruptCallback = NULL_PTR
        dmaLogicChannel_HwChId = DMA_IP_HW_CH_17
        dmaLogicChannel_HwInstId = DMA_IP_HW_INST_0
        dmaLogicChannel_InterruptCallback = Lpuart_6_Uart_Ip_DmaRxCompleteCallback
        dmaLogicChannel_LogicName = DMA_LOGIC_CH_1
        dmaLogicChannel_ConfigType
          dmaLogicChannel_GlobalConfigType
            dmaLogicChannelConfig_GlobalControlType: dmaGlobalControl_enBufferedWrites=false, dmaGlobalControl_enMasterIdReplication=false
            dmaLogicChannelConfig_GlobalInterruptType: dmaGlobalInterrupt_enDmaErrorInterrupt=false
            dmaLogicChannelConfig_GlobalPriorityType:
              dmaGlobalPriority_GroupPriority = DMA_IP_GROUP_PRIO0
              dmaGlobalPriority_LevelPriority = DMA_IP_LEVEL_PRIO0
              dmaGlobalPriority_disPreempt = false
              dmaGlobalPriority_enPreemption = false
            dmaLogicChannelConfig_GlobalRequestType: dmaGlobalRequest_enDmaRequest=false
          dmaLogicChannel_ScatterGatherConfigType
          dmaLogicChannel_TransferConfigType
            dmaLogicChannelConfig_TransferControlType:
              dmaLogicChannelConfig_DestinationStoreAddressType = 0U
              dmaLogicChannelConfig_ScatterGatherAddressType = 0U
              dmaLogicChannelConfig_bandwidthControl = DMA_IP_BWC_ENGINE_NO_STALL
              dmaLogicChannelConfig_disDmaAutoHwReq = false
              dmaLogicChannelConfig_enDmaHalfMajorInterrupt = false
              dmaLogicChannelConfig_enDmaMajorInterrupt = false
              dmaLogicChannelConfig_enEndOfPacketSignal = false
            dmaLogicChannelConfig_TransferDestinationType:
              dmaLogicChannelConfig_DestinationAddressType = 0
              dmaLogicChannelConfig_DestinationLastAddressAdjustmentType = 0
              dmaLogicChannelConfig_DestinationModuloType = 0
              dmaLogicChannelConfig_DestinationSignedOffsetType = 0
              dmaTransferConfig_TransferSizeType = DMA_IP_TRANSFER_SIZE_1_BYTE
            dmaLogicChannelConfig_TransferMajorLoopType: dmaLogicChannelConfig_MajorLoopCountType=1, dmaLogicChannelConfig_enMajorLoopLinkCh=false
            dmaLogicChannelConfig_TransferMinorLoopType:
              dmaLogicChannelConfig_MinorLoopSizeType = 0
              dmaLogicChannelConfig_OffsetValueType = 0
              dmaLogicChannelConfig_enDestinationOffset = false
              dmaLogicChannelConfig_enMinorLoopLinkCh = false
              dmaLogicChannelConfig_enSourceOffset = false
            dmaLogicChannelConfig_TransferSourceType:
              dmaLogicChannelConfig_SourceAddressType = 0
              dmaLogicChannelConfig_SourceLastAddressAdjustmentType = 0
              dmaLogicChannelConfig_SourceModuloType = 0
              dmaLogicChannelConfig_SourceSignedOffsetType = 0
              dmaTransferConfig_TransferSizeType = DMA_IP_TRANSFER_SIZE_1_BYTE
      dmaLogicInstance_ConfigType_UART6 (dmaLogicInstance_ConfigType):
        index = 0
        dmaLogicInstance_IdName = DMA_LOGIC_INST_0
        dmaLogicInstance_enChLinking = false
        dmaLogicInstance_enDebug = false
        dmaLogicInstance_enGlMasterIdReplication = false
        dmaLogicInstance_enHaltAfterError = false
        dmaLogicInstance_enRoundRobin = false
        dmaLogicInstance_hwId = DMA_IP_HW_INST_0
    MclGeneral:
      MclEnableDemReportErrorStatus = false
      MclEnableDevErrorDetect = false
      MclEnableMultipartitionSupport = false
      MclEnableUserModeSupport = false
      MclEnableVirtualAddressMappingSupport = false
      Mcl_VersionInfoApi = false
      MclCache: MclEnableCache=true
      MclDma: MclEnableDma=true
      MclEmiosCommon: MclEnableEmiosCommon=false
      MclFlexioCommon: MclEnableFlexioCommon=false
      MclLcuConfig: MclEnableLcu=false, MclEnableLcuAsyncFunc=false, MclEnableLcuSyncFunc=false
      MclTrgMux: MclEnableTrgMux=false
