AUTOSAR XML (schema 00050)
package /Dio
  module config Dio: implementation-config-variant=VARIANT-PRE-COMPILE
    CommonPublishedInformation:
      ArReleaseMajorVersion = 4
      ArReleaseMinorVersion = 7
      ArReleaseRevisionVersion = 0
      ModuleId = 120
      SwMajorVersion = 5
      SwMinorVersion = 0
      SwPatchVersion = 0
      VendorApiInfix = 
      VendorId = 43
    DioConfig
      DioPort_AH (DioPort): index=0, DioPortId=1
        3 x DioChannel, all with PDACSlot=VIRTUAL_WRAPPER_PDAC0:
          DioChannel_PA29: index=0, DioChannelId=13
          DioChannel_PA30: index=1, DioChannelId=14
          DioChannel_PA31: index=2, DioChannelId=15
      DioPort_BH (DioPort): index=1, DioPortId=3
        DioChannel_PB19 (DioChannel): index=0, DioChannelId=3, PDACSlot=VIRTUAL_WRAPPER_PDAC0
        DioChannel_PB18 (DioChannel): index=1, DioChannelId=2, PDACSlot=VIRTUAL_WRAPPER_PDAC0
    DioGeneral:
      DioDevErrorDetect = false
      DioEnableUserModeSupport = false
      DioFlipChannelApi = true
      DioMaskedWritePortApi = false
      DioMultiPartitionSupport = false
      DioReadZeroForUndefinedPortPins = false
      DioReversePortBits = false
      DioVersionInfoApi = false
      DioVirtWrapperSupport = false
      SIUL2DioIPDevErrorDetect = false
