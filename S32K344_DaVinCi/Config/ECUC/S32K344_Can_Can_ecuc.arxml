AUTOSAR XML (schema 00050)
package /Can_43_FLEXCAN
  module config Can: implementation-config-variant=VARIANT-POST-BUILD
    CanConfigSet
      CanController_0 (CanController):
        index = 0
        CanAutoBusOffRecovery = true
        CanBusoffProcessing = POLLING
        CanClockFromBus = false
        CanControllerActivation = true
        CanControllerBaseAddress = 0
        CanControllerEdgeFilter = false
        CanControllerFdISO = true
        CanControllerId = 0
        CanControllerPrExcEn = false
        CanHwChannel = FLEXCAN_0
        CanLoopBackMode = false
        CanRxProcessing = POLLING
        CanTrippleSamplingEnable = false
        CanTxProcessing = POLLING
        CanWakeupFunctionalityAPI = false
        CanWakeupProcessing = POLLING
        CanWakeupSupport = false
        CanControllerDefaultBaudrate = CanControllerBaudrateConfig_250K
        CanCpuClockRef = McuClockReferencePoint_CanClock
        CanCpuClockRefAlternate = (unset)
        CanControllerBaudrateConfig_250K (CanControllerBaudrateConfig):
          index = 0
          CanAdvancedSetting = false
          CanBaudrateTypeSuport = ENHANCE_CBT
          CanBusLength = 40
          CanControllerBaudRate = 250
          CanControllerBaudRateConfigID = 0
          CanControllerPrescaller = 16
          CanControllerPrescallerAlternate = 10
          CanControllerPropSeg = 7
          CanControllerSeg1 = 8
          CanControllerSeg2 = 4
          CanControllerSyncJumpWidth = 1
          CanControllerSyncSeg = 1
          CanPropDelayTranceiver = 150
          CanTxArbitrationStartDelay = 12
        CanControllerBaudrateConfig_500K (CanControllerBaudrateConfig):
          index = 1
          CanAdvancedSetting = false
          CanBaudrateTypeSuport = ENHANCE_CBT
          CanBusLength = 40
          CanControllerBaudRate = 500
          CanControllerBaudRateConfigID = 1
          CanControllerPrescaller = 8
          CanControllerPrescallerAlternate = 10
          CanControllerPropSeg = 7
          CanControllerSeg1 = 8
          CanControllerSeg2 = 4
          CanControllerSyncJumpWidth = 1
          CanControllerSyncSeg = 1
          CanPropDelayTranceiver = 150
          CanTxArbitrationStartDelay = 12
        CanRxFiFo
          CanRxFiFo (CanEnhanceFiFo):
            CanEnhanceFiFoDmaEnable = false
            CanEnhancedSchemeType = MASK_FILTER_SCHEME
            CanFiFoDmaErrorNotif = NULL_PTR
            CanFiFoOverflowNotif = NULL_PTR
            NumberMBTransferDMA = 1
      CanHardwareObject_0 (CanHardwareObject):
        index = 0
        CanHandleType = BASIC
        CanHwObjectCount = 16
        CanIdType = EXTENDED
        CanObjectId = 0
        CanObjectPayloadLength = CAN_OBJECT_PL_8
        CanObjectType = RECEIVE
        CanControllerRef = CanController_0
        CanMainFunctionRWPeriodRef = CanMainFunctionRWPeriods_0
        13 x CanHwFilter, all with CanHwFilterMask=536870911:
          CanHwFilter_0: index=0, CanHwFilterCode=402784001
          CanHwFilter_1: index=1, CanHwFilterCode=402784002
          CanHwFilter_2: index=2, CanHwFilterCode=402784003
          CanHwFilter_3: index=3, CanHwFilterCode=402784004
          CanHwFilter_4: index=4, CanHwFilterCode=402784005
          CanHwFilter_5: index=5, CanHwFilterCode=402784006
          CanHwFilter_6: index=6, CanHwFilterCode=402784007
          CanHwFilter_7: index=7, CanHwFilterCode=402784008
          CanHwFilter_8: index=8, CanHwFilterCode=402784009
          CanHwFilter_9: index=9, CanHwFilterCode=402784010
          CanHwFilter_10: index=10, CanHwFilterCode=402849537
          CanHwFilter_11: index=11, CanHwFilterCode=402719231
          CanHwFilter_12: index=12, CanHwFilterCode=402849537
      CanHardwareObject_1 (CanHardwareObject):
        index = 1
        CanHandleType = BASIC
        CanHwObjectCount = 5
        CanIdType = EXTENDED
        CanObjectId = 1
        CanObjectType = TRANSMIT
        CanControllerRef = CanController_0
        CanMainFunctionRWPeriodRef = CanMainFunctionRWPeriods_0
    CanGeneral:
      CanDevErrorDetect = false
      CanEnableDualClockMode = false
      CanEnableSecurityEventReporting = false
      CanEnableUserModeSupport = false
      CanGlobalTimeSupport = false
      CanIndex = 0
      CanLPduReceiveCalloutFunction = BSW_CanRxCallout
      CanMBCountExtensionSupport = true
      CanMainFunctionModePeriod = 0.002
      CanMultiPartitionSupport = false
      CanMultiplexedTransmission = true
      CanTimeoutDuration = 1
      CanTimeoutMethod = OSIF_COUNTER_DUMMY
      CanVersionInfoApi = false
      LPduHrhExtendSupport = false
      CanSupportTTCANRef = (unset)
      CanMainFunctionRWPeriods_0 (CanMainFunctionRWPeriods): index=0, CanMainFunctionPeriod=0.002
    CommonPublishedInformation:
      ArReleaseMajorVersion = 4
      ArReleaseMinorVersion = 7
      ArReleaseRevisionVersion = 0
      ModuleId = 80
      SwMajorVersion = 5
      SwMinorVersion = 0
      SwPatchVersion = 0
      VendorApiInfix = FLEXCAN
      VendorId = 43
