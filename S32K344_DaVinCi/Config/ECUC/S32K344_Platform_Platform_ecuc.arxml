AUTOSAR XML (schema 00050)
package /Platform
  module config Platform: implementation-config-variant=VARIANT-PRE-COMPILE
    CommonPublishedInformation:
      ArReleaseMajorVersion = 4
      ArReleaseMinorVersion = 7
      ArReleaseRevisionVersion = 0
      ModuleId = 255
      SwMajorVersion = 5
      SwMinorVersion = 0
      SwPatchVersion = 0
      VendorId = 43
    GeneralConfiguration:
      PlatformDevErrorDetect = true
      PlatformEnableIntCtrlConfiguration = true
      PlatformEnableUserModeSupport = false
      PlatformEnableVtorConfiguration = false
      PlatformIntmConfigurable = false
      PlatformIpAPIsAvailable = false
      PlatformMcmConfigurable = false
      PlatformMpuM7Configurable = false
      PlatformMulticoreSupport = false
    IntCtrlConfig_0 (IntCtrlConfig): PlatformVtorAddressConfig=0
      146 x PlatformIsrConfig:
        PlatformIsrConfig_{0..3}: index={0..3}, IsrEnabled=false, IsrHandler=undefined_handler, IsrName=INT{0..3}_IRQn, IsrPriority=0
        PlatformIsrConfig_4: index=4, IsrEnabled=false, IsrHandler=undefined_handler, IsrName=DMATCD0_IRQn, IsrPriority=0
        PlatformIsrConfig_5: index=5, IsrEnabled=false, IsrHandler=undefined_handler, IsrName=DMATCD1_IRQn, IsrPriority=0
        PlatformIsrConfig_6: index=6, IsrEnabled=false, IsrHandler=undefined_handler, IsrName=DMATCD2_IRQn, IsrPriority=0
        PlatformIsrConfig_7: index=7, IsrEnabled=false, IsrHandler=undefined_handler, IsrName=DMATCD3_IRQn, IsrPriority=0
        PlatformIsrConfig_8: index=8, IsrEnabled=false, IsrHandler=undefined_handler, IsrName=DMATCD4_IRQn, IsrPriority=0
        PlatformIsrConfig_9: index=9, IsrEnabled=false, IsrHandler=undefined_handler, IsrName=DMATCD5_IRQn, IsrPriority=0
        PlatformIsrConfig_10: index=10, IsrEnabled=false, IsrHandler=undefined_handler, IsrName=DMATCD6_IRQn, IsrPriority=0
        PlatformIsrConfig_11: index=11, IsrEnabled=false, IsrHandler=undefined_handler, IsrName=DMATCD7_IRQn, IsrPriority=0
        PlatformIsrConfig_12: index=12, IsrEnabled=false, IsrHandler=undefined_handler, IsrName=DMATCD8_IRQn, IsrPriority=0
        PlatformIsrConfig_13: index=13, IsrEnabled=false, IsrHandler=undefined_handler, IsrName=DMATCD9_IRQn, IsrPriority=0
        PlatformIsrConfig_14: index=14, IsrEnabled=false, IsrHandler=undefined_handler, IsrName=DMATCD10_IRQn, IsrPriority=0
        PlatformIsrConfig_15: index=15, IsrEnabled=false, IsrHandler=undefined_handler, IsrName=DMATCD11_IRQn, IsrPriority=0
        PlatformIsrConfig_16: index=16, IsrEnabled=false, IsrHandler=undefined_handler, IsrName=DMATCD12_IRQn, IsrPriority=0
        PlatformIsrConfig_17: index=17, IsrEnabled=false, IsrHandler=undefined_handler, IsrName=DMATCD13_IRQn, IsrPriority=0
        PlatformIsrConfig_18: index=18, IsrEnabled=false, IsrHandler=undefined_handler, IsrName=DMATCD14_IRQn, IsrPriority=0
        PlatformIsrConfig_19: index=19, IsrEnabled=false, IsrHandler=undefined_handler, IsrName=DMATCD15_IRQn, IsrPriority=0
        PlatformIsrConfig_20: index=20, IsrEnabled=true, IsrHandler=Dma0_Ch16_IRQHandler, IsrName=DMATCD16_IRQn, IsrPriority=14
        PlatformIsrConfig_21: index=21, IsrEnabled=true, IsrHandler=Dma0_Ch17_IRQHandler, IsrName=DMATCD17_IRQn, IsrPriority=14
        PlatformIsrConfig_22: index=22, IsrEnabled=false, IsrHandler=undefined_handler, IsrName=DMATCD18_IRQn, IsrPriority=0
        PlatformIsrConfig_23: index=23, IsrEnabled=false, IsrHandler=undefined_handler, IsrName=DMATCD19_IRQn, IsrPriority=0
        PlatformIsrConfig_24: index=24, IsrEnabled=false, IsrHandler=undefined_handler, IsrName=DMATCD20_IRQn, IsrPriority=0
        PlatformIsrConfig_25: index=25, IsrEnabled=false, IsrHandler=undefined_handler, IsrName=DMATCD21_IRQn, IsrPriority=0
        PlatformIsrConfig_26: index=26, IsrEnabled=false, IsrHandler=undefined_handler, IsrName=DMATCD22_IRQn, IsrPriority=0
        PlatformIsrConfig_27: index=27, IsrEnabled=false, IsrHandler=undefined_handler, IsrName=DMATCD23_IRQn, IsrPriority=0
        PlatformIsrConfig_28: index=28, IsrEnabled=false, IsrHandler=undefined_handler, IsrName=DMATCD24_IRQn, IsrPriority=0
        PlatformIsrConfig_29: index=29, IsrEnabled=false, IsrHandler=undefined_handler, IsrName=DMATCD25_IRQn, IsrPriority=0
        PlatformIsrConfig_30: index=30, IsrEnabled=false, IsrHandler=undefined_handler, IsrName=DMATCD26_IRQn, IsrPriority=0
        PlatformIsrConfig_31: index=31, IsrEnabled=false, IsrHandler=undefined_handler, IsrName=DMATCD27_IRQn, IsrPriority=0
        PlatformIsrConfig_32: index=32, IsrEnabled=false, IsrHandler=undefined_handler, IsrName=DMATCD28_IRQn, IsrPriority=0
        PlatformIsrConfig_33: index=33, IsrEnabled=false, IsrHandler=undefined_handler, IsrName=DMATCD29_IRQn, IsrPriority=0
        PlatformIsrConfig_34: index=34, IsrEnabled=false, IsrHandler=undefined_handler, IsrName=DMATCD30_IRQn, IsrPriority=0
        PlatformIsrConfig_35: index=35, IsrEnabled=false, IsrHandler=undefined_handler, IsrName=DMATCD31_IRQn, IsrPriority=0
        PlatformIsrConfig_36: index=36, IsrEnabled=false, IsrHandler=undefined_handler, IsrName=ERM_0_IRQn, IsrPriority=0
        PlatformIsrConfig_37: index=37, IsrEnabled=false, IsrHandler=undefined_handler, IsrName=ERM_1_IRQn, IsrPriority=0
        PlatformIsrConfig_38: index=38, IsrEnabled=false, IsrHandler=undefined_handler, IsrName=MCM_IRQn, IsrPriority=0
        PlatformIsrConfig_39: index=39, IsrEnabled=false, IsrHandler=undefined_handler, IsrName=STM0_IRQn, IsrPriority=0
        PlatformIsrConfig_40: index=40, IsrEnabled=false, IsrHandler=undefined_handler, IsrName=STM1_IRQn, IsrPriority=0
        PlatformIsrConfig_41: index=41, IsrEnabled=true, IsrHandler=Swt_Ip_Swt0_Isr, IsrName=SWT0_IRQn, IsrPriority=1
        PlatformIsrConfig_42: index=42, IsrEnabled=false, IsrHandler=undefined_handler, IsrName=CTI0_IRQn, IsrPriority=0
        PlatformIsrConfig_43: index=43, IsrEnabled=false, IsrHandler=undefined_handler, IsrName=FLASH_0_IRQn, IsrPriority=0
        PlatformIsrConfig_44: index=44, IsrEnabled=false, IsrHandler=undefined_handler, IsrName=FLASH_1_IRQn, IsrPriority=0
        PlatformIsrConfig_45: index=45, IsrEnabled=false, IsrHandler=undefined_handler, IsrName=FLASH_2_IRQn, IsrPriority=0
        PlatformIsrConfig_46: index=46, IsrEnabled=false, IsrHandler=undefined_handler, IsrName=RGM_IRQn, IsrPriority=0
        PlatformIsrConfig_47: index=47, IsrEnabled=false, IsrHandler=undefined_handler, IsrName=PMC_IRQn, IsrPriority=0
        PlatformIsrConfig_48: index=48, IsrEnabled=false, IsrHandler=undefined_handler, IsrName=SIUL_0_IRQn, IsrPriority=0
        PlatformIsrConfig_49: index=49, IsrEnabled=false, IsrHandler=undefined_handler, IsrName=SIUL_1_IRQn, IsrPriority=0
        PlatformIsrConfig_50: index=50, IsrEnabled=false, IsrHandler=undefined_handler, IsrName=SIUL_2_IRQn, IsrPriority=0
        PlatformIsrConfig_51: index=51, IsrEnabled=false, IsrHandler=undefined_handler, IsrName=SIUL_3_IRQn, IsrPriority=0
        PlatformIsrConfig_52: index=52, IsrEnabled=false, IsrHandler=undefined_handler, IsrName=EMIOS0_0_IRQn, IsrPriority=0
        PlatformIsrConfig_53: index=53, IsrEnabled=false, IsrHandler=undefined_handler, IsrName=EMIOS0_1_IRQn, IsrPriority=0
        PlatformIsrConfig_54: index=54, IsrEnabled=false, IsrHandler=undefined_handler, IsrName=EMIOS0_2_IRQn, IsrPriority=0
        PlatformIsrConfig_55: index=55, IsrEnabled=false, IsrHandler=undefined_handler, IsrName=EMIOS0_3_IRQn, IsrPriority=0
        PlatformIsrConfig_56: index=56, IsrEnabled=false, IsrHandler=undefined_handler, IsrName=EMIOS0_4_IRQn, IsrPriority=0
        PlatformIsrConfig_57: index=57, IsrEnabled=false, IsrHandler=undefined_handler, IsrName=EMIOS0_5_IRQn, IsrPriority=0
        PlatformIsrConfig_58: index=58, IsrEnabled=false, IsrHandler=undefined_handler, IsrName=EMIOS1_0_IRQn, IsrPriority=0
        PlatformIsrConfig_59: index=59, IsrEnabled=false, IsrHandler=undefined_handler, IsrName=EMIOS1_1_IRQn, IsrPriority=0
        PlatformIsrConfig_60: index=60, IsrEnabled=false, IsrHandler=undefined_handler, IsrName=EMIOS1_2_IRQn, IsrPriority=0
        PlatformIsrConfig_61: index=61, IsrEnabled=false, IsrHandler=undefined_handler, IsrName=EMIOS1_3_IRQn, IsrPriority=0
        PlatformIsrConfig_62: index=62, IsrEnabled=false, IsrHandler=undefined_handler, IsrName=EMIOS1_4_IRQn, IsrPriority=0
        PlatformIsrConfig_63: index=63, IsrEnabled=false, IsrHandler=undefined_handler, IsrName=EMIOS1_5_IRQn, IsrPriority=0
        PlatformIsrConfig_64: index=64, IsrEnabled=false, IsrHandler=undefined_handler, IsrName=EMIOS2_0_IRQn, IsrPriority=0
        PlatformIsrConfig_65: index=65, IsrEnabled=false, IsrHandler=undefined_handler, IsrName=EMIOS2_1_IRQn, IsrPriority=0
        PlatformIsrConfig_66: index=66, IsrEnabled=false, IsrHandler=undefined_handler, IsrName=EMIOS2_2_IRQn, IsrPriority=0
        PlatformIsrConfig_67: index=67, IsrEnabled=false, IsrHandler=undefined_handler, IsrName=EMIOS2_3_IRQn, IsrPriority=0
        PlatformIsrConfig_68: index=68, IsrEnabled=false, IsrHandler=undefined_handler, IsrName=EMIOS2_4_IRQn, IsrPriority=0
        PlatformIsrConfig_69: index=69, IsrEnabled=false, IsrHandler=undefined_handler, IsrName=EMIOS2_5_IRQn, IsrPriority=0
        PlatformIsrConfig_70: index=70, IsrEnabled=true, IsrHandler=undefined_handler, IsrName=WKPU_IRQn, IsrPriority=14
        PlatformIsrConfig_71: index=71, IsrEnabled=false, IsrHandler=undefined_handler, IsrName=CMU0_IRQn, IsrPriority=0
        PlatformIsrConfig_72: index=72, IsrEnabled=false, IsrHandler=undefined_handler, IsrName=CMU1_IRQn, IsrPriority=0
        PlatformIsrConfig_73: index=73, IsrEnabled=false, IsrHandler=undefined_handler, IsrName=CMU2_IRQn, IsrPriority=0
        PlatformIsrConfig_74: index=74, IsrEnabled=false, IsrHandler=undefined_handler, IsrName=BCTU_IRQn, IsrPriority=0
        PlatformIsrConfig_75: index=75, IsrEnabled=false, IsrHandler=undefined_handler, IsrName=LCU0_IRQn, IsrPriority=0
        PlatformIsrConfig_76: index=76, IsrEnabled=false, IsrHandler=undefined_handler, IsrName=LCU1_IRQn, IsrPriority=0
        PlatformIsrConfig_77: index=77, IsrEnabled=true, IsrHandler=PIT_0_ISR, IsrName=PIT0_IRQn, IsrPriority=15
        PlatformIsrConfig_78: index=78, IsrEnabled=false, IsrHandler=undefined_handler, IsrName=PIT1_IRQn, IsrPriority=0
        PlatformIsrConfig_79: index=79, IsrEnabled=false, IsrHandler=undefined_handler, IsrName=PIT2_IRQn, IsrPriority=0
        PlatformIsrConfig_80: index=80, IsrEnabled=false, IsrHandler=undefined_handler, IsrName=RTC_IRQn, IsrPriority=0
        PlatformIsrConfig_81: index=81, IsrEnabled=false, IsrHandler=undefined_handler, IsrName=EMAC_0_IRQn, IsrPriority=0
        PlatformIsrConfig_82: index=82, IsrEnabled=false, IsrHandler=undefined_handler, IsrName=EMAC_1_IRQn, IsrPriority=0
        PlatformIsrConfig_83: index=83, IsrEnabled=false, IsrHandler=undefined_handler, IsrName=EMAC_2_IRQn, IsrPriority=0
        PlatformIsrConfig_84: index=84, IsrEnabled=false, IsrHandler=undefined_handler, IsrName=EMAC_3_IRQn, IsrPriority=0
        PlatformIsrConfig_85: index=85, IsrEnabled=false, IsrHandler=undefined_handler, IsrName=FlexCAN0_0_IRQn, IsrPriority=0
        PlatformIsrConfig_86: index=86, IsrEnabled=false, IsrHandler=undefined_handler, IsrName=FlexCAN0_1_IRQn, IsrPriority=0
        PlatformIsrConfig_87: index=87, IsrEnabled=false, IsrHandler=undefined_handler, IsrName=FlexCAN0_2_IRQn, IsrPriority=0
        PlatformIsrConfig_88: index=88, IsrEnabled=false, IsrHandler=undefined_handler, IsrName=FlexCAN0_3_IRQn, IsrPriority=0
        PlatformIsrConfig_89: index=89, IsrEnabled=false, IsrHandler=undefined_handler, IsrName=FlexCAN1_0_IRQn, IsrPriority=0
        PlatformIsrConfig_90: index=90, IsrEnabled=false, IsrHandler=undefined_handler, IsrName=FlexCAN1_1_IRQn, IsrPriority=0
        PlatformIsrConfig_91: index=91, IsrEnabled=false, IsrHandler=undefined_handler, IsrName=FlexCAN1_2_IRQn, IsrPriority=0
        PlatformIsrConfig_92: index=92, IsrEnabled=false, IsrHandler=undefined_handler, IsrName=FlexCAN2_0_IRQn, IsrPriority=0
        PlatformIsrConfig_93: index=93, IsrEnabled=false, IsrHandler=undefined_handler, IsrName=FlexCAN2_1_IRQn, IsrPriority=0
        PlatformIsrConfig_94: index=94, IsrEnabled=false, IsrHandler=undefined_handler, IsrName=FlexCAN2_2_IRQn, IsrPriority=0
        PlatformIsrConfig_95: index=95, IsrEnabled=false, IsrHandler=undefined_handler, IsrName=FlexCAN3_0_IRQn, IsrPriority=0
        PlatformIsrConfig_96: index=96, IsrEnabled=false, IsrHandler=undefined_handler, IsrName=FlexCAN3_1_IRQn, IsrPriority=0
        PlatformIsrConfig_97: index=97, IsrEnabled=false, IsrHandler=undefined_handler, IsrName=FlexCAN4_0_IRQn, IsrPriority=0
        PlatformIsrConfig_98: index=98, IsrEnabled=false, IsrHandler=undefined_handler, IsrName=FlexCAN4_1_IRQn, IsrPriority=0
        PlatformIsrConfig_99: index=99, IsrEnabled=false, IsrHandler=undefined_handler, IsrName=FlexCAN5_0_IRQn, IsrPriority=0
        PlatformIsrConfig_100: index=100, IsrEnabled=false, IsrHandler=undefined_handler, IsrName=FlexCAN5_1_IRQn, IsrPriority=0
        PlatformIsrConfig_101: index=101, IsrEnabled=false, IsrHandler=undefined_handler, IsrName=FLEXIO_IRQn, IsrPriority=0
        PlatformIsrConfig_102: index=102, IsrEnabled=false, IsrHandler=undefined_handler, IsrName=LPUART0_IRQn, IsrPriority=0
        PlatformIsrConfig_103: index=103, IsrEnabled=false, IsrHandler=undefined_handler, IsrName=LPUART1_IRQn, IsrPriority=0
        PlatformIsrConfig_104: index=104, IsrEnabled=false, IsrHandler=undefined_handler, IsrName=LPUART2_IRQn, IsrPriority=0
        PlatformIsrConfig_105: index=105, IsrEnabled=false, IsrHandler=undefined_handler, IsrName=LPUART3_IRQn, IsrPriority=0
        PlatformIsrConfig_106: index=106, IsrEnabled=false, IsrHandler=undefined_handler, IsrName=LPUART4_IRQn, IsrPriority=0
        PlatformIsrConfig_107: index=107, IsrEnabled=false, IsrHandler=undefined_handler, IsrName=LPUART5_IRQn, IsrPriority=0
        PlatformIsrConfig_108: index=108, IsrEnabled=false, IsrHandler=undefined_handler, IsrName=LPUART6_IRQn, IsrPriority=0
        PlatformIsrConfig_109: index=109, IsrEnabled=false, IsrHandler=undefined_handler, IsrName=LPUART7_IRQn, IsrPriority=0
        PlatformIsrConfig_110: index=110, IsrEnabled=false, IsrHandler=undefined_handler, IsrName=LPUART8_IRQn, IsrPriority=0
        PlatformIsrConfig_111: index=111, IsrEnabled=false, IsrHandler=undefined_handler, IsrName=LPUART9_IRQn, IsrPriority=0
        PlatformIsrConfig_112: index=112, IsrEnabled=false, IsrHandler=undefined_handler, IsrName=LPUART10_IRQn, IsrPriority=0
        PlatformIsrConfig_113: index=113, IsrEnabled=false, IsrHandler=undefined_handler, IsrName=LPUART11_IRQn, IsrPriority=0
        PlatformIsrConfig_114: index=114, IsrEnabled=false, IsrHandler=undefined_handler, IsrName=LPUART12_IRQn, IsrPriority=0
        PlatformIsrConfig_115: index=115, IsrEnabled=false, IsrHandler=undefined_handler, IsrName=LPUART13_IRQn, IsrPriority=0
        PlatformIsrConfig_116: index=116, IsrEnabled=false, IsrHandler=undefined_handler, IsrName=LPUART14_IRQn, IsrPriority=0
        PlatformIsrConfig_117: index=117, IsrEnabled=false, IsrHandler=undefined_handler, IsrName=LPUART15_IRQn, IsrPriority=0
        PlatformIsrConfig_118: index=118, IsrEnabled=false, IsrHandler=undefined_handler, IsrName=LPI2C0_IRQn, IsrPriority=0
        PlatformIsrConfig_119: index=119, IsrEnabled=false, IsrHandler=undefined_handler, IsrName=LPI2C1_IRQn, IsrPriority=0
        PlatformIsrConfig_120: index=120, IsrEnabled=false, IsrHandler=undefined_handler, IsrName=LPSPI0_IRQn, IsrPriority=0
        PlatformIsrConfig_121: index=121, IsrEnabled=false, IsrHandler=undefined_handler, IsrName=LPSPI1_IRQn, IsrPriority=0
        PlatformIsrConfig_122: index=122, IsrEnabled=false, IsrHandler=undefined_handler, IsrName=LPSPI2_IRQn, IsrPriority=0
        PlatformIsrConfig_123: index=123, IsrEnabled=false, IsrHandler=undefined_handler, IsrName=LPSPI3_IRQn, IsrPriority=0
        PlatformIsrConfig_124: index=124, IsrEnabled=false, IsrHandler=undefined_handler, IsrName=LPSPI4_IRQn, IsrPriority=0
        PlatformIsrConfig_125: index=125, IsrEnabled=false, IsrHandler=undefined_handler, IsrName=LPSPI5_IRQn, IsrPriority=0
        PlatformIsrConfig_126: index=126, IsrEnabled=false, IsrHandler=undefined_handler, IsrName=QSPI_IRQn, IsrPriority=0
        PlatformIsrConfig_127: index=127, IsrEnabled=false, IsrHandler=undefined_handler, IsrName=SAI0_IRQn, IsrPriority=0
        PlatformIsrConfig_128: index=128, IsrEnabled=false, IsrHandler=undefined_handler, IsrName=SAI1_IRQn, IsrPriority=0
        PlatformIsrConfig_129: index=129, IsrEnabled=false, IsrHandler=undefined_handler, IsrName=JDC_IRQn, IsrPriority=0
        PlatformIsrConfig_130: index=130, IsrEnabled=false, IsrHandler=undefined_handler, IsrName=ADC0_IRQn, IsrPriority=0
        PlatformIsrConfig_131: index=131, IsrEnabled=false, IsrHandler=undefined_handler, IsrName=ADC1_IRQn, IsrPriority=0
        PlatformIsrConfig_132: index=132, IsrEnabled=false, IsrHandler=undefined_handler, IsrName=ADC2_IRQn, IsrPriority=0
        PlatformIsrConfig_133: index=133, IsrEnabled=false, IsrHandler=undefined_handler, IsrName=LPCMP0_IRQn, IsrPriority=0
        PlatformIsrConfig_134: index=134, IsrEnabled=false, IsrHandler=undefined_handler, IsrName=LPCMP1_IRQn, IsrPriority=0
        PlatformIsrConfig_135: index=135, IsrEnabled=false, IsrHandler=undefined_handler, IsrName=LPCMP2_IRQn, IsrPriority=0
        PlatformIsrConfig_136: index=136, IsrEnabled=false, IsrHandler=undefined_handler, IsrName=FCCU_0_IRQn, IsrPriority=0
        PlatformIsrConfig_137: index=137, IsrEnabled=false, IsrHandler=undefined_handler, IsrName=FCCU_1_IRQn, IsrPriority=0
        PlatformIsrConfig_138: index=138, IsrEnabled=false, IsrHandler=undefined_handler, IsrName=STCU_LBIST_MBIST_IRQn, IsrPriority=0
        PlatformIsrConfig_139: index=139, IsrEnabled=false, IsrHandler=undefined_handler, IsrName=HSE_MU0_TX_IRQn, IsrPriority=0
        PlatformIsrConfig_140: index=140, IsrEnabled=false, IsrHandler=undefined_handler, IsrName=HSE_MU0_RX_IRQn, IsrPriority=0
        PlatformIsrConfig_141: index=141, IsrEnabled=false, IsrHandler=undefined_handler, IsrName=HSE_MU0_ORED_IRQn, IsrPriority=0
        PlatformIsrConfig_142: index=142, IsrEnabled=false, IsrHandler=undefined_handler, IsrName=HSE_MU1_TX_IRQn, IsrPriority=0
        PlatformIsrConfig_143: index=143, IsrEnabled=false, IsrHandler=undefined_handler, IsrName=HSE_MU1_RX_IRQn, IsrPriority=0
        PlatformIsrConfig_144: index=144, IsrEnabled=false, IsrHandler=undefined_handler, IsrName=HSE_MU1_ORED_IRQn, IsrPriority=0
        PlatformIsrConfig_145: index=145, IsrEnabled=false, IsrHandler=undefined_handler, IsrName=SoC_PLL_IRQn, IsrPriority=0
    IntmConfig
    MPU_M7_Configuration
