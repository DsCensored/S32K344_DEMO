AUTOSAR XML (schema 00050)
package /Icu
  module config Icu: implementation-config-variant=VARIANT-POST-BUILD
    CommonPublishedInformation:
      ArReleaseMajorVersion = 4
      ArReleaseMinorVersion = 7
      ArReleaseRevisionVersion = 0
      ModuleId = 122
      SwMajorVersion = 5
      SwMinorVersion = 0
      SwPatchVersion = 0
      VendorId = 43
    IcuAutosarExt:
      IcuEnableDualClockMode = false
      IcuGetCaptureRegisterValueApi = false
      IcuGetInputLevelApi = false
      IcuOverflowNotificationApi = false
      IcuSaicEdgeCapturing = false
      IcuSetInitialCounterValue = false
      IcuSetMaxCounterValue = false
      IcuSupportSAICModeApi = false
      IcuWkpuStandbyWakeupSupport = true
    IcuConfigSet: IcuMaxChannel=2
      IcuChannel_CAN0RXWKUP (IcuChannel):
        index = 0
        IcuChannelId = 0
        IcuDMAChannelEnable = false
        IcuDefaultStartEdge = ICU_FALLING_EDGE
        IcuMeasurementMode = ICU_MODE_SIGNAL_EDGE_DETECT
        IcuOverflowNotification = NULL_PTR
        IcuWakeupCapability = true
        IcuChannelRef = IcuWkpuChannels_CAN0
        IcuSignalEdgeDetection
        IcuWakeup: IcuChannelWakeupInfo=EcuMWakeupSource_0
      IcuChannel_KL15WKUP (IcuChannel):
        index = 1
        IcuChannelId = 1
        IcuDMAChannelEnable = false
        IcuDefaultStartEdge = ICU_RISING_EDGE
        IcuMeasurementMode = ICU_MODE_SIGNAL_EDGE_DETECT
        IcuOverflowNotification = NULL_PTR
        IcuWakeupCapability = true
        IcuChannelRef = IcuWkpuChannels_KL15
        IcuSignalEdgeDetection
        IcuWakeup: IcuChannelWakeupInfo=EcuMWakeupSource_0
      IcuHwInterruptConfigList_0 (IcuHwInterruptConfigList): index=0, IcuIsrHwId=WKPU_CH_19
      IcuHwInterruptConfigList_1 (IcuHwInterruptConfigList): index=1, IcuIsrHwId=WKPU_CH_42
      IcuWkpu_0 (IcuWkpu)
        IcuWkpuChannels_CAN0 (IcuWkpuChannels): index=0, IcuWKPU_ISR_WIPUER=false, IcuWkpuChannel=19, Icu_EXT_ISR_WIFERDigitalFilter=false
        IcuWkpuChannels_KL15 (IcuWkpuChannels): index=1, IcuWKPU_ISR_WIPUER=false, IcuWkpuChannel=42, Icu_EXT_ISR_WIFERDigitalFilter=false
    IcuGeneral: IcuDevErrorDetect=true, IcuEnableUserModeSupport=false, IcuMultiPartitionSupport=false, IcuReportWakeupSource=true
    IcuOptionalApis:
      IcuDeInitApi = true
      IcuDisableWakeupApi = true
      IcuEdgeCountApi = true
      IcuEdgeDetectApi = true
      IcuEnableWakeupApi = true
      IcuGetDutyCycleValuesApi = true
      IcuGetInputStateApi = true
      IcuGetTimeElapsedApi = true
      IcuGetVersionInfoApi = true
      IcuSetModeApi = true
      IcuSignalMeasurementApi = true
      IcuTimestampApi = true
      IcuWakeupFunctionalityApi = true
