AUTOSAR XML (schema 00050)
package /MemAcc
  module config MemAcc: implementation-config-variant=VARIANT-PRE-COMPILE
    AutosarExt: MemAccEnableUserModeSupport=false, MemAccMulticoreType1Support=false, MemAccMulticoreType3Support=false
    CommonPublishedInformation:
      ArReleaseMajorVersion = 4
      ArReleaseMinorVersion = 7
      ArReleaseRevisionVersion = 0
      ModuleId = 41
      SwMajorVersion = 5
      SwMinorVersion = 0
      SwPatchVersion = 0
      VendorId = 43
    MemAccAddressAreaConfiguration_0 (MemAccAddressAreaConfiguration): index=0, MemAccAddressAreaId=0, MemAccAddressAreaPriority=0, MemAccBufferAlignmentValue=1, MemAccJobEndNotificationName=Fee_JobEndNotification
      4 x MemAccSubAddressAreaConfiguration, all with MemAccMemInvocation=INDIRECT_STATIC, MemAccMemNamePrefix=Mem_43_INFLS, MemAccNumberOfSectors=1, MemAccSectorOffset=0, MemAccUseEraseBurst=false, MemAccUseReadBurst=false, MemAccUseWriteBurst=false:
        MemAccSubAddressAreaConfiguration_0: index=0, MemAccLogicalStartAddress=0, MemAccSectorBatchRef=MemSectorBatch_5
        MemAccSubAddressAreaConfiguration_1: index=1, MemAccLogicalStartAddress=8192, MemAccSectorBatchRef=MemSectorBatch_6
        MemAccSubAddressAreaConfiguration_2: index=2, MemAccLogicalStartAddress=16384, MemAccSectorBatchRef=MemSectorBatch_7
        MemAccSubAddressAreaConfiguration_3: index=3, MemAccLogicalStartAddress=24576, MemAccSectorBatchRef=MemSectorBatch_8
    MemAccGeneral:
      MemAcc64BitSupport = false
      MemAccCompareApi = false
      MemAccCompareBufferSize = 128
      MemAccDevErrorDetect = false
      MemAccMainFunctionPeriod = 0.005
      MemAccTimeoutMethod = OSIF_COUNTER_DUMMY
      MemAccUseMemFuncPtrTable = false
