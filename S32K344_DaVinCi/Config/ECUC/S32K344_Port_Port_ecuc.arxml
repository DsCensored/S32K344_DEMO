AUTOSAR XML (schema 00050)
package /Port
  module config Port: implementation-config-variant=VARIANT-POST-BUILD
    CommonPublishedInformation:
      ArReleaseMajorVersion = 4
      ArReleaseMinorVersion = 7
      ArReleaseRevisionVersion = 0
      ModuleId = 124
      SwMajorVersion = 5
      SwMinorVersion = 0
      SwPatchVersion = 0
      VendorApiInfix = 
      VendorId = 43
    PortConfigSet
      NotUsedPortPin: PortPinDirection=PORT_PIN_IN, PortPinLevelValue=PORT_PIN_LEVEL_LOW, PortPinPue=false, PortPinPus=false
      PortContainer_1 (PortContainer): PortNumberOfPortPins=9
        9 x PortPin, all with ImcrPdacSlot=VIRTUAL_WRAPPER_PDAC0, MscrPdacSlot=VIRTUAL_WRAPPER_PDAC0, OBEGroupSelect=NO_OBE_GROUP, PortPinDirectionChangeable=true, PortPinDse=false, PortPinIfe=false, PortPinInitialMode=PORT_GPIO_MODE, PortPinInvertControl=false, PortPinModeChangeable=true, PortPinPke=false, PortPinPue=false, PortPinPus=false, PortPinSafeMode=false, PortPinSiul2Instance=SIUL2_0, PortPinSlewRate=SLEW_RATE_NOT_AVAILABLE, PortPinWithReadBack=false:
          PortPin_CAN0_RX_PA6: index=0, PortPinDirection=PORT_PIN_IN, PortPinId=1, PortPinLevelValue=PORT_PIN_LEVEL_HIGH, PortPinMode=CAN0_CAN0_RX_IN, PortPinPcr=6
          PortPin_CAN0_TX_PA7: index=1, PortPinDirection=PORT_PIN_OUT, PortPinId=2, PortPinLevelValue=PORT_PIN_LEVEL_HIGH, PortPinMode=CAN0_CAN0_TX_OUT, PortPinPcr=7
          PortPin_UART6_RX_PA15: index=2, PortPinDirection=PORT_PIN_IN, PortPinId=3, PortPinLevelValue=PORT_PIN_LEVEL_LOW, PortPinMode=LPUART6_LPUART6_RX_IN, PortPinPcr=15
          PortPin_UART6_TX_PA16: index=3, PortPinDirection=PORT_PIN_OUT, PortPinId=4, PortPinLevelValue=PORT_PIN_LEVEL_LOW, PortPinMode=LPUART6_LPUART6_TX_OUT, PortPinPcr=16
          PortPin_LED0_PA29: index=4, PortPinDirection=PORT_PIN_OUT, PortPinId=5, PortPinLevelValue=PORT_PIN_LEVEL_HIGH, PortPinMode=GPIO, PortPinPcr=29
          PortPin_KL15_PB19: index=5, PortPinDirection=PORT_PIN_IN, PortPinId=6, PortPinLevelValue=PORT_PIN_LEVEL_LOW, PortPinMode=WKPU_WKPU_38_IN, PortPinPcr=51
          PortPin_LED1_PA30: index=6, PortPinDirection=PORT_PIN_OUT, PortPinId=7, PortPinLevelValue=PORT_PIN_LEVEL_HIGH, PortPinMode=GPIO, PortPinPcr=30
          PortPin_LED2_PA31: index=7, PortPinDirection=PORT_PIN_OUT, PortPinId=8, PortPinLevelValue=PORT_PIN_LEVEL_HIGH, PortPinMode=GPIO, PortPinPcr=31
          PortPin_LED3_PB18: index=8, PortPinDirection=PORT_PIN_OUT, PortPinId=9, PortPinLevelValue=PORT_PIN_LEVEL_HIGH, PortPinMode=GPIO, PortPinPcr=50
      4 x UnTouchedPortPin, all with PortPinSiul2Instance=SIUL2_0:
        JTAGC_TCK: PortPinPcr=68
        JTAGC_TDI: PortPinPcr=4
        JTAGC_TDO: PortPinPcr=10
        JTAGC_TMS: PortPinPcr=69
    PortGeneral:
      PortCodeSizeOptimization = false
      PortDevErrorDetect = true
      PortEnableUserModeSupport = false
      PortMultiPartitionSupport = false
      PortResetPinModeApi = false
      PortSetAsUnusedPinApi = false
      PortSetPinDirectionApi = true
      PortSetPinModeApi = true
      PortSetPinModeDoesNotTouchGpioLevel = false
      PortTspcSupport = false
      PortVersionInfoApi = true
      SIUL2PortIPDevErrorDetect = false
      SignalInversionConfigEnable = false
      VirtWrapperSupport = false
