AUTOSAR XML (schema 00050)
package /Uart
  module config Uart: implementation-config-variant=VARIANT-POST-BUILD
    CommonPublishedInformation:
      ArReleaseMajorVersion = 4
      ArReleaseMinorVersion = 7
      ArReleaseRevisionVersion = 0
      ModuleId = 255
      SwMajorVersion = 5
      SwMinorVersion = 0
      SwPatchVersion = 0
      VendorApiInfix = 
      VendorId = 43
    GeneralConfiguration:
      DisableUartRuntimeErrorDetect = false
      UartCallback = BSW_UARTCallback
      UartCallbackCapability = true
      UartDevErrorDetect = true
      UartDmaEnable = true
      UartEnableUserModeSupport = false
      UartMultipartitionSupport = false
      UartTimeoutDuration = 1000
      UartTimeoutMethod = OSIF_COUNTER_DUMMY
      UartVersionInfoApi = true
    UartGlobalConfig
      UartChannel_0 (UartChannel): UartChannelId=0, UartHwUsing=LPUART_IP, UartClockRef=McuClockReferencePoint_UART6Clock
        DetailModuleConfiguration:
          CustomBaudrateDivisor = 4
          CustomBaudrateMantissa = 1
          CustomBaudrateValue = 0
          DesireBaudrate = LPUART_UART_BAUDRATE_115200
          UartHwChannel = LPUART_6
          UartInternalLoopbackEnable = false
          UartInteruptDmaMethod = LPUART_UART_IP_USING_DMA
          UartParityType = LPUART_UART_IP_PARITY_DISABLED
          UartStopBitNumber = LPUART_UART_IP_ONE_STOP_BIT
          UartTimeoutEnable = false
          UartWordLength = LPUART_UART_IP_8_BITS_PER_CHAR
          UartDmaRxChannelRef = dmaLogicChannel_Type_UART6_RX
          UartDmaTxChannelRef = dmaLogicChannel_Type_UART6_TX
