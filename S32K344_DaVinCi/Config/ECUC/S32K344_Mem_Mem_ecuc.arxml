AUTOSAR XML (schema 00050)
package /Mem_43_INFLS
  module config Mem: implementation-config-variant=VARIANT-PRE-COMPILE
    CommonPublishedInformation:
      ArReleaseMajorVersion = 4
      ArReleaseMinorVersion = 7
      ArReleaseRevisionVersion = 0
      ModuleId = 91
      SwMajorVersion = 5
      SwMinorVersion = 0
      SwPatchVersion = 0
      VendorApiInfix = INFLS
      VendorId = 43
    MemAutosarExt:
      MemBlock4PipeSelect = MEM_COMMAND_PIPE_0
      MemEccDataErrorSuppression = true
      MemEnableUserModeSupport = false
      MemSynchronizeCache = false
      MemUsesAlterInterface = false
    MemGeneral:
      MemAbortTimeout = 32767
      MemAcErase = 541261568
      MemAcErasePointer = NULL_PTR
      MemAcLoadOnJobStart = true
      MemAcWrite = 541261568
      MemAcWritePointer = NULL_PTR
      MemCleanCacheAfterLoadAc = true
      MemDevErrorDetect = true
      MemEnableCheckCfgCrc = false
      MemEraseTimeout = 2147483647
      MemEraseVerificationEnabled = true
      MemHwCompareService = true
      MemHwUtestModeService = false
      MemSectorSetLockApi = true
      MemSyncModeEnable = false
      MemTimeoutMethod = OSIF_COUNTER_DUMMY
      MemTimeoutSupervisionEnabled = false
      MemUtestResumeTimeout = 32767
      MemUtestSuspendTimeout = 32767
      MemWriteTimeout = 2147483647
      MemWriteVerificationEnabled = true
      Mem_SemaphoreAddress = 0
      Mem_SemaphoreSymbol = NULL
      Mem_SoftwareSemaphoreSupport = false
    MemInstance_0 (MemInstance): MemInstanceId=0
      9 x MemSectorBatch, all with MemEraseSectorSize=8192, MemSpecifiedEraseCycles=0:
        MemSectorBatch_0: index=0, MemNumberOfSectors=32, MemPhysicalSector=FLS_CODE_ARRAY_0_BLOCK_0_S000, MemReadPageSize=128, MemStartAddress=4194304, MemWritePageSize=128
        MemSectorBatch_1: index=1, MemNumberOfSectors=2, MemPhysicalSector=FLS_CODE_ARRAY_0_BLOCK_0_S032, MemReadPageSize=128, MemStartAddress=4456448, MemWritePageSize=128
        MemSectorBatch_2: index=2, MemNumberOfSectors=198, MemPhysicalSector=FLS_CODE_ARRAY_0_BLOCK_0_S036, MemReadPageSize=128, MemStartAddress=4489216, MemWritePageSize=128
        MemSectorBatch_3: index=3, MemNumberOfSectors=58, MemPhysicalSector=FLS_CODE_ARRAY_0_BLOCK_1_S234, MemReadPageSize=128, MemStartAddress=6111232, MemWritePageSize=128
        MemSectorBatch_4: index=4, MemNumberOfSectors=198, MemPhysicalSector=FLS_CODE_ARRAY_0_BLOCK_2_S292, MemReadPageSize=128, MemStartAddress=6586368, MemWritePageSize=128
        MemSectorBatch_5: index=5, MemNumberOfSectors=1, MemPhysicalSector=FLS_DATA_ARRAY_0_BLOCK_4_S000, MemReadPageSize=1, MemStartAddress=268435456, MemWritePageSize=8
        MemSectorBatch_6: index=6, MemNumberOfSectors=1, MemPhysicalSector=FLS_DATA_ARRAY_0_BLOCK_4_S001, MemReadPageSize=1, MemStartAddress=268443648, MemWritePageSize=8
        MemSectorBatch_7: index=7, MemNumberOfSectors=1, MemPhysicalSector=FLS_DATA_ARRAY_0_BLOCK_4_S002, MemReadPageSize=1, MemStartAddress=268451840, MemWritePageSize=8
        MemSectorBatch_8: index=8, MemNumberOfSectors=1, MemPhysicalSector=FLS_DATA_ARRAY_0_BLOCK_4_S003, MemReadPageSize=1, MemStartAddress=268460032, MemWritePageSize=8
    MemPublishedInformation: MemECCValue=1427461397, MemErasedValue=4294967295
