AUTOSAR XML (schema 00050)
package /EcuM
  module config EcuM: implementation-config-variant=VARIANT-POST-BUILD
    CommonPublishedInformation:
      ArReleaseMajorVersion = 4
      ArReleaseMinorVersion = 7
      ArReleaseRevisionVersion = 0
      ModuleId = 10
      SwMajorVersion = 5
      SwMinorVersion = 0
      SwPatchVersion = 0
      VendorId = 43
    EcuMConfiguration
      EcuMCommonConfiguration: EcuMConfigConsistencyHash=0, EcuMDefaultAppMode=(unset), EcuMOSResource=(unset)
        EcuMDefaultShutdownTarget: EcuMDefaultState=EcuMStateOff
        EcuMSleepMode_0 (EcuMSleepMode): EcuMSleepModeId=1, EcuMSleepModeSuspend=true, EcuMSleepModeMcuModeRef=McuModeSettingConf_0, EcuMWakeupSourceMask=EcuMWakeupSource_0
        EcuMWakeupSource_0 (EcuMWakeupSource): EcuMWakeupSourceId=0, EcuMWakeupSourcePolling=true
    EcuMGeneral: EcuMDevErrorDetect=true, EcuMIncludeDet=true, EcuMMainFunctionPeriod=0.01, EcuMVersionInfoApi=true
