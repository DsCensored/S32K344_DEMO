AUTOSAR XML (schema 00050)
package /Resource
  module config Resource
    CommonPublishedInformation:
      ArReleaseMajorVersion = 4
      ArReleaseMinorVersion = 7
      ArReleaseRevisionVersion = 0
      ModuleId = 0
      SwMajorVersion = 5
      SwMinorVersion = 0
      SwPatchVersion = 0
      VendorId = 43
    ResourceGeneral: ARM_CoreArchitecture=ARM_M_ARCH, ResourceSubderivative=s32k344_hdqfp172
