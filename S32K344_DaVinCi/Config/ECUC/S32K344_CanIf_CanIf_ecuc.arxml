AUTOSAR XML (schema 00050)
package /CanIf
  module config CanIf: implementation-config-variant=VARIANT-LINK-TIME
    CanIfCtrlDrvCfg_0 (CanIfCtrlDrvCfg): index=0, CanIfCtrlDrvNameRef=CanGeneral
      CanIfCtrlCfg_0 (CanIfCtrlCfg): index=0, CanIfCtrlId=0, CanIfCtrlCanCtrlRef=CanController_0
    CanIfDispatchCfg: CanIfDispatchUserCtrlBusOffUL=CDD
    CanIfInitCfg
      CanIfBufferCfg_0 (CanIfBufferCfg): index=0, CanIfBufferHthRef=CanIfHthCfg_0
      CanIfInitHohCfg_CAN0 (CanIfInitHohCfg): index=0
        CanIfHrhCfg_0 (CanIfHrhCfg): index=0, CanIfHrhCanCtrlIdRef=CanIfCtrlCfg_0, CanIfHrhIdSymRef=CanHardwareObject_0
        CanIfHthCfg_0 (CanIfHthCfg): index=0, CanIfHthCanCtrlIdRef=CanIfCtrlCfg_0, CanIfHthIdSymRef=CanHardwareObject_1
    CanIfPublicCfg: CanIfDevErrorDetect=false
