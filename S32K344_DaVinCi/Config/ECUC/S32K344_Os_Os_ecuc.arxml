AUTOSAR XML (schema 00050)
package /Os
  module config Os: implementation-config-variant=VARIANT-PRE-COMPILE
    OsApplication_0 (OsApplication)
