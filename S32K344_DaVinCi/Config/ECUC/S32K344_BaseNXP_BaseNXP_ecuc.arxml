AUTOSAR XML (schema 00050)
package /BaseNXP
  module config BaseNXP: implementation-config-variant=VARIANT-PRE-COMPILE
    CommonPublishedInformation:
      ArReleaseMajorVersion = 4
      ArReleaseMinorVersion = 7
      ArReleaseRevisionVersion = 0
      ModuleId = 0
      SwMajorVersion = 5
      SwMinorVersion = 0
      SwPatchVersion = 0
      VendorId = 43
    OsIfGeneral:
      OsIfDevErrorDetect = false
      OsIfEnableUserModeSupport = false
      OsIfGetPhysicalCoreIdEnable = false
      OsIfInstanceId = 0
      OsIfMulticoreSupport = false
      OsIfPhysicalCoreId = AUTOMATE
      OsIfUseCustomTimer = false
      OsIfUseGetUserId = GET_CORE_ID
      OsIfUseSystemTimer = false
      OsIfOperatingSystemType
        OsIfOperatingSystemType (OsIfAutosarOsType)
