AUTOSAR XML (schema 00050)
package /Wdg
  module config Wdg: implementation-config-variant=VARIANT-POST-BUILD
    CommonPublishedInformation:
      ArReleaseMajorVersion = 4
      ArReleaseMinorVersion = 7
      ArReleaseRevisionVersion = 0
      ModuleId = 102
      SwMajorVersion = 5
      SwMinorVersion = 0
      SwPatchVersion = 0
      VendorApiInfix = Instance0
      VendorId = 43
    WdgClockReferencePoint_0 (WdgClockReferencePoint): WdgClockReference=McuClockReferencePoint_WDGClock
    WdgDemEventParameterRefs: WDG_E_DISABLE_REJECTED=DemEventParameter_0, WDG_E_MODE_FAILED=DemEventParameter_0
    WdgGeneral:
      WdgCallbackNotification = Wdg_CallBackNotification0
      WdgDevErrorDetect = true
      WdgDisableAllowed = true
      WdgEnableClearResetRequest = true
      WdgEnableDirectService = true
      WdgEnableMultiPartitionSupport = false
      WdgEnableUserModeSupport = false
      WdgIndex = 0
      WdgInitialTimeout = 10
      WdgMaxTimeout = 12
      WdgOsifTimeoutVal = 3000
      WdgRunArea = ROM
      WdgTimeoutMethod = OSIF_COUNTER_DUMMY
      WdgVersionInfoApi = true
      AutosarExt: WdgDisableDemReportErrorStatus=false
    WdgPublishedInformation: WdgTriggerMode=WDG_BOTH
    WdgSettingsConfig: WdgDefaultMode=WDGIF_SLOW_MODE, WdgInstance=SWT0, WdgInterruptContentEnable=true, WdgExternalTriggerCounterRef=(unset)
      WdgSettingsFast:
        WdgClockSelection = OscillatorClock
        WdgClockValue = 32
        WdgHardLockConfiguration = false
        WdgKeyedService = false
        WdgMasterAccessProtectionforMaster{0..7} = true
        WdgOperationMode = Interrupt
        WdgResetOnInvalidAccess = SystemReset
        WdgRunsInDebugMode = false
        WdgRunsInStopMode = false
        WdgServiceKeyValue = 0
        WdgSoftLockConfiguration = true
        WdgTimeoutPeriod = 10
        WdgWindowMode = false
        WdgWindowPeriod = 0.01
        WdgClkSrcRef = WdgClockReferencePoint_0
      WdgSettingsOff: WdgHardLockConfiguration=false, WdgSoftLockConfiguration=true
      WdgSettingsSlow:
        WdgClockSelection = OscillatorClock
        WdgClockValue = 32
        WdgHardLockConfiguration = false
        WdgKeyedService = false
        WdgMasterAccessProtectionforMaster{0..7} = true
        WdgOperationMode = Interrupt
        WdgResetOnInvalidAccess = SystemReset
        WdgRunsInDebugMode = false
        WdgRunsInStopMode = false
        WdgServiceKeyValue = 0
        WdgSoftLockConfiguration = true
        WdgTimeoutPeriod = 10
        WdgWindowMode = false
        WdgWindowPeriod = 0
        WdgClkSrcRef = WdgClockReferencePoint_0
