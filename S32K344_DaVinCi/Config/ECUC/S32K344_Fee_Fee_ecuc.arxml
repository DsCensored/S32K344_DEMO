AUTOSAR XML (schema 00050)
package /Fee
  module config Fee: implementation-config-variant=VARIANT-PRE-COMPILE
    CommonPublishedInformation:
      ArReleaseMajorVersion = 4
      ArReleaseMinorVersion = 7
      ArReleaseRevisionVersion = 0
      ModuleId = 21
      SwMajorVersion = 5
      SwMinorVersion = 0
      SwPatchVersion = 0
      VendorId = 43
    4 x FeeBlockConfiguration, all with FeeBlockAssignment=APPLICATION, FeeBlockSize=256, FeeImmediateData=false, FeeNumberOfWriteCycles=0, FeeClusterGroupRef=FeeClusterGroup_0, FeeMemAccAddressArea=MemAccAddressAreaConfiguration_0:
      FeeBlockConfiguration_0: FeeBlockNumber=1
      FeeBlockConfiguration_1: FeeBlockNumber=2
      FeeBlockConfiguration_2: FeeBlockNumber=3
      FeeBlockConfiguration_3: FeeBlockNumber=4
    FeeClusterGroup_0 (FeeClusterGroup)
      FeeCluster_0 (FeeCluster)
        FeeSubAddressArea_0 (FeeSubAddressArea): FeeSubAddressAreaIndex=0, FeeSubAddressAreaRef=MemAccSubAddressAreaConfiguration_0
        FeeSubAddressArea_1 (FeeSubAddressArea): FeeSubAddressAreaIndex=1, FeeSubAddressAreaRef=MemAccSubAddressAreaConfiguration_1
      FeeCluster_1 (FeeCluster)
        FeeSubAddressArea_0 (FeeSubAddressArea): FeeSubAddressAreaIndex=0, FeeSubAddressAreaRef=MemAccSubAddressAreaConfiguration_2
        FeeSubAddressArea_1 (FeeSubAddressArea): FeeSubAddressAreaIndex=1, FeeSubAddressAreaRef=MemAccSubAddressAreaConfiguration_3
    FeeGeneral:
      FeeBlockAlwaysAvailable = false
      FeeConfigAssignment = APPLICATION
      FeeDataBufferSize = 384
      FeeDevErrorDetect = true
      FeeEnableUserModeSupport = false
      FeeLegacyEraseMode = false
      FeeMainFunctionPeriod = 0.005
      FeeMarkEmptyBlocksInvalid = false
      FeeMaximumNumberBlocks = 4
      FeeMinimumReadPageSize = 1
      FeePollingMode = false
      FeeSetModeSupported = false
      FeeSubAddressAreaEraseRetries = 3
      FeeSubAddressAreaRetirement = false
      FeeSwapForeignBlocksEnabled = false
      FeeVersionInfoApi = true
      FeeVirtualPageSize = 32
      FeeBufferAlignmentValue = MemAccAddressAreaConfiguration_0
    FeePublishedInformation: FeeBlockOverhead=0, FeePageOverhead=0
