AUTOSAR XML (schema 00050)
package /Gpt
  module config Gpt
