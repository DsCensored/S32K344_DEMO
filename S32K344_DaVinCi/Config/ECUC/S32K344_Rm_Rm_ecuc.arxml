AUTOSAR XML (schema 00050)
package /Rm
  module config Rm: implementation-config-variant=VARIANT-PRE-COMPILE
    CommonPublishedInformation:
      ArReleaseMajorVersion = 4
      ArReleaseMinorVersion = 7
      ArReleaseRevisionVersion = 0
      ModuleId = 255
      SwMajorVersion = 5
      SwMinorVersion = 0
      SwPatchVersion = 0
      VendorId = 43
    RmConfigSet
      Crossbar_Configuration: CrossbarDevErrorDetect=true
      Dma_Mux_Configuration: Dma_Mux_DevErrorDetect=true
        Dma_Mux_Module_Config_0 (Dma_Mux_Module_Config):
          index = 0
          Dma_Mux_Enable_Trigger = false
          Dma_Mux_HwChannel = DMA_CHANNEL_16
          Dma_Mux_HwInstance = DMA_INSTANCE_0
          Dma_Mux_Source0 = DMA_MUX_0_REQ_DISABLED
          Dma_Mux_Source1 = DMA_MUX_1_LPUART_6_TRANSMIT
          Dma_Mux_Source2 = NOT_USED
          Dma_Mux_Source3 = NOT_USED
        Dma_Mux_Module_Config_1 (Dma_Mux_Module_Config):
          index = 1
          Dma_Mux_Enable_Trigger = false
          Dma_Mux_HwChannel = DMA_CHANNEL_17
          Dma_Mux_HwInstance = DMA_INSTANCE_0
          Dma_Mux_Source0 = DMA_MUX_0_REQ_DISABLED
          Dma_Mux_Source1 = DMA_MUX_1_LPUART_6_RECEIVE
          Dma_Mux_Source2 = NOT_USED
          Dma_Mux_Source3 = NOT_USED
      Mscm_Configuration: MscmDevErrorDetect=true
      Pflash_Configuration: PflashDevErrorDetect=true
      Sema42_ModuleConfig: Sema42DevErrorDetect=true
      Virt_Wrapper_Configuration: VirtWrapperDevErrorDetect=true
      Xbic_Configuration: XbicDevErrorDetect=true
      Xrdc_Configuration: XrdcCRLockBit=false, XrdcDevErrorDetect=true, XrdcPIDRegisterLock=XRDC_PID_UNLOCKED, XrdcRegistersLock=false
    RmGeneral:
      RmCrossbarConfigurable = false
      RmDevErrorDetect = true
      RmEnableDmaMuxSupport = true
      RmEnableGlobalInit = true
      RmEnableMscmSupport = false
      RmEnableSema42Support = false
      RmEnableUserModeSupport = false
      RmEnableXRDCSupport = false
      RmPflashConfigurable = false
      RmVirtWrapperConfigurable = false
      RmXbicConfigurable = false
      Rm_VersionInfoApi = true
